/* 5x7 bitmap font (ASCII 32–127). Glyphs from Adafruit-GFX-Library glcdfont.c (BSD).
 * Same table as hal_v2/common/hal_draw_cpu.cpp — row per glyph row, MSB = left column. */
static const uint8_t kAfOsdFont5x7[96][7] = {
    {0x00, 0x00, 0x00, 0x00, 0x00, 0x00, 0x00}, {0x08, 0x08, 0x08, 0x08, 0x08, 0x00, 0x08},
    {0x14, 0x14, 0x14, 0x00, 0x00, 0x00, 0x00}, {0x14, 0x14, 0x3E, 0x14, 0x3E, 0x14, 0x14},
    {0x08, 0x1E, 0x28, 0x1C, 0x0A, 0x3C, 0x08}, {0x30, 0x32, 0x04, 0x08, 0x10, 0x26, 0x06},
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    {0x10, 0x2A, 0x04, 0x00, 0x00, 0x00, 0x00}, {0x08, 0x1C, 0x36, 0x22, 0x22, 0x3E, 0x00}};
